/*
 * oled.c
 *
 *  Created on: 22.10.2026
 *      Author: joelw
 */


#include "main.h"
#include "oled.h"
#include "music.h"
#include "ssd1306.h"
#include <stdio.h>


const unsigned char  image_1[]={
		0xff, 0xff, 0xff, 0xff, 0xc0, 0x00, 0x00, 0x00, 0x00, 0x00, 0x0f, 0xff, 0xff, 0xff, 0xff, 0xff,
		0xff, 0xff, 0xff, 0xff, 0xd4, 0x00, 0x00, 0x00, 0x02, 0x40, 0x2b, 0xff, 0xff, 0xff, 0xff, 0xff,
		0xff, 0xff, 0xff, 0xff, 0xc0, 0x08, 0x14, 0x00, 0x00, 0x08, 0x0d, 0xff, 0xff, 0xff, 0xff, 0xff,
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		0xff, 0xf7, 0xf7, 0xff, 0xfd, 0xed, 0xb7, 0xef, 0xf7, 0x24, 0xaa, 0x49, 0xbe, 0xf6, 0xff, 0xfd
	};

// 'ICh', 128x64px
const unsigned char image_2 []= {
	0xff, 0xff, 0xff, 0x6a, 0x8a, 0xa0, 0xa2, 0x5f, 0x6a, 0xaa, 0xaa, 0xaa, 0xaa, 0xaa, 0xad, 0xb5,
	0xff, 0xfb, 0x55, 0xa8, 0x51, 0x4a, 0x01, 0x55, 0xdf, 0xed, 0x55, 0x55, 0x55, 0x55, 0xaa, 0xd4,
	0xdf, 0xbe, 0xfe, 0xaa, 0x89, 0x24, 0x28, 0x97, 0xff, 0xf5, 0x55, 0x55, 0x49, 0x56, 0xb6, 0xaa,
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	0x77, 0x74, 0x88, 0x40, 0x40, 0x08, 0x09, 0x40, 0x02, 0xbe, 0x00, 0x00, 0x16, 0xa5, 0x35, 0x25
};

oled_line_t screen_1[3] =
{
    {"Liebe", {23, 7}, &Font_16x26},
    {"Zita",  {31, 37}, &Font_16x26}
};

oled_line_t screen_2[3] =
{
    {"alles",       {38, 0},  &Font_11x18},
    {"Gute zum",    {20, 21}, &Font_11x18},
    {"Geburtstag",  {10, 44}, &Font_11x18}
};

oled_line_t screen_3[3] =
{
    {"ich liebe ", {15, 15}, &Font_11x18},
    {"Dich",       {40, 35}, &Font_11x18}
};

oled_line_t screen_4[3] =
{
    {"Dein",   {30, 7},  &Font_16x26},
    {"Joel <3", {5, 37}, &Font_16x26}
};

oled_screen_t birthday_screens[] =
{
    {screen_1, 2000},
    {screen_2, 5500},
    {screen_3, 5500},
    {screen_4, 5500}
};


/******************************************************
 * schaltet led nach bitmuster an

*******************************************************/
uint8_t countdown(uint8_t number, uint8_t *reset)
{
    static uint32_t countdown_timer = 0;
    static int8_t n;
    char buffer[4];

    if(*reset)
    {
    	countdown_timer=0;
    	n=number;
    	*reset=0;
    }

    // Piep nach kurzer Zeit wieder ausschalten
    if(HAL_GetTick() >= countdown_timer - 850)
    {
    	buzzer_set_frequency(0);
    	 if(n<0)
    	    	return 1;
    }

    if(HAL_GetTick() >= countdown_timer)
    {
        countdown_timer = HAL_GetTick() +1000;
        SSD1306_Clear();

        // Zahl anzeigen
        sprintf(buffer, "%d", n);

        if(n >= 10)
            SSD1306_GotoXY(48, 20);
        else
            SSD1306_GotoXY(56, 20);
        SSD1306_Puts(buffer, &Font_16x26, SSD1306_COLOR_WHITE);

        SSD1306_UpdateScreen();

        buzzer_set_frequency(2000);

        n--;
    }
    return 0;
}


/******************************************************
 * schaltet led nach bitmuster an

*******************************************************/
uint8_t ShowText(oled_screen_t *liste, uint8_t list_size, uint8_t *reset)
{

	static uint32_t screen_timer=0;
	static uint8_t i=0, j=0;

	if(*reset)
	{
		i=0;
		j=0;
		*reset=0;
	}


	if(HAL_GetTick()>= screen_timer)
	{
		if(i>=list_size)
			return 1;

		SSD1306_Clear();

		for(j=0; j<3; j++)
		{
			if(liste[i].line[j].text==NULL)
				break;

			SSD1306_GotoXY(liste[i].line[j].pos.x, liste[i].line[j].pos.y);
			SSD1306_Puts(liste[i].line[j].text, liste[i].line[j].Font, SSD1306_COLOR_WHITE);
		}
		SSD1306_UpdateScreen();

		screen_timer=HAL_GetTick()+liste[i].delay;

		i++;
	}

	return 0;
}



/******************************************************
 * schaltet led nach bitmuster an

*******************************************************/
void ShowTime(RTC_TimeTypeDef sTime)
{
	static uint32_t timer=0;
	char timeString[9];

	if(HAL_GetTick()>=timer)
	{
		timer=HAL_GetTick()+1000;
		sprintf(timeString, "%02d:%02d:%02d", sTime.Hours, sTime.Minutes, sTime.Seconds);
		SSD1306_GotoXY(20, 20);
		SSD1306_Clear();
		SSD1306_Puts(timeString, &Font_11x18, SSD1306_COLOR_WHITE);
		SSD1306_UpdateScreen();
	}
}

/******************************************************
 * schaltet led nach bitmuster an
*******************************************************/
uint8_t show_image(uint8_t reps, uint8_t *reset)
{
    static uint32_t image_timer = 0;
    static uint8_t count = 0;
    static uint8_t image = 0;

    if(*reset)
    {
        count = 0;
        image = 0;
        image_timer = 0;
        *reset = 0;
    }

    if(HAL_GetTick() >= image_timer)
    {
        // Sind alle Bilder gezeigt?
        if(reps <= count)
        {
            return 1;
        }

        SSD1306_Fill(SSD1306_COLOR_BLACK);

        if(image == 0)
        {
            SSD1306_DrawBitmap(0, 0, image_1, 128, 64, SSD1306_COLOR_WHITE);
            image = 1;
        }
        else
        {
            SSD1306_DrawBitmap(0, 0, image_2, 128, 64, SSD1306_COLOR_WHITE);
            image = 0;
            count++;
        }

        SSD1306_UpdateScreen();

        image_timer = HAL_GetTick() + 3000;
    }

    return 0;
}
